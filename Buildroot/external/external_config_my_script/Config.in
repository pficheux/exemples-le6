## Buildroot/external/external_config_service/package/my_script/Config.in
```kconfig
config BR2_PACKAGE_MY_SCRIPT
	bool "My service script"
	help
		A simple service started at boot time
```

## Buildroot/external/external_config_skeleton/Config.in
```kconfig
source "$BR2_EXTERNAL_SKEL_PATH/package/hello-autotools/Config.in"
source "$BR2_EXTERNAL_SKEL_PATH/package/hello-cmake/Config.in"
source "$BR2_EXTERNAL_SKEL_PATH/package/hello-generic/Config.in"
source "$BR2_EXTERNAL_SKEL_PATH/package/hello-module/Config.in"
source "$BR2_EXTERNAL_SKEL_PATH/package/hello-cmake-git/Config.in"
source "$BR2_EXTERNAL_SKEL_PATH/package/hello-cmake-hash/Config.in"
source "$BR2_EXTERNAL_SKEL_PATH/package/my-script/Config.in"
```

## Buildroot/external/external_config_skeleton/configs/qemu_aarch64_virt_defconfig
```kconfig
BR2_aarch64=y
BR2_TOOLCHAIN_EXTERNAL=y
BR2_GLOBAL_PATCH_DIR="board/qemu/patches"
BR2_DOWNLOAD_FORCE_CHECK_HASHES=y
BR2_SYSTEM_DHCP="eth0"
BR2_ROOTFS_OVERLAY="$(BR2_EXTERNAL)/board/qemu/aarch64-virt/my-overlay"
BR2_ROOTFS_POST_IMAGE_SCRIPT="board/qemu/post-image.sh"
BR2_ROOTFS_POST_SCRIPT_ARGS="$(BR2_DEFCONFIG)"
BR2_LINUX_KERNEL=y
BR2_LINUX_KERNEL_CUSTOM_VERSION=y
BR2_LINUX_KERNEL_CUSTOM_VERSION_VALUE="6.12.47"
BR2_LINUX_KERNEL_USE_CUSTOM_CONFIG=y
BR2_LINUX_KERNEL_CUSTOM_CONFIG_FILE="board/qemu/aarch64-virt/linux.config"
BR2_LINUX_KERNEL_CONFIG_FRAGMENT_FILES="$(BR2_EXTERNAL)/board/qemu/aarch64-virt/ikconfig.fragment"
BR2_LINUX_KERNEL_NEEDS_HOST_OPENSSL=y
BR2_TARGET_ROOTFS_EXT2=y
BR2_TARGET_ROOTFS_EXT2_4=y
# BR2_TARGET_ROOTFS_TAR is not set
BR2_PACKAGE_MY_SCRIPT=y
BR2_PACKAGE_HELLO_AUTOTOOLS=y
BR2_PACKAGE_HELLO_CMAKE=y
BR2_PACKAGE_HELLO_GENERIC=y
BR2_PACKAGE_HELLO_MODULE=y
BR2_PACKAGE_HELLO_CMAKE_GIT=y
BR2_PACKAGE_HELLO_CMAKE_HASH=y
```

## Buildroot/external/external_config_skeleton/package/hello-cmake-git/Config.in
```kconfig
config BR2_PACKAGE_HELLO_CMAKE_GIT
	bool "CMake + GitHub 
	help
		Hello world CMake + GitHub
```

## Buildroot/external/external_config_skeleton/package/hello-cmake-hash/Config.in
```kconfig
config BR2_PACKAGE_HELLO_CMAKE_HASH
	bool "CMake example with hash file"
	help
		Hello world CMake package + hash file
```

## Buildroot/external/external_config_skeleton/package/hello-generic/Config.in
```kconfig
config BR2_PACKAGE_HELLO_GENERIC
	bool "Generic Makefile example"
#	select BR2_PACKAGE_SIMPLE_DEPENDENCY
	depends on BR2_PACKAGE_SIMPLE_DEPENDENCY

	help
		Hello world generic package	
```

## Buildroot/external/external_config_skeleton/package/hello-module/Config.in
```kconfig
config BR2_PACKAGE_HELLO_MODULE
	bool "Hello World kernel module"
	help
		A simple Hello World kernel module
		
```

## Buildroot/external/external_config_skeleton/package/hello_autotools/Config.in
```kconfig
config BR2_PACKAGE_HELLO_AUTOTOOLS
	bool "Autotools example"
	help
		Hello world Autotools package	
```

## Buildroot/external/external_config_skeleton/package/hello_cmake/Config.in
```kconfig
config BR2_PACKAGE_HELLO_CMAKE
	bool "CMake example"
	help
		Hello world CMake package
```

## Buildroot/external/external_config_skeleton/package/simple-dependency/Config.in
```kconfig
config BR2_PACKAGE_SIMPLE_DEPENDENCY
	bool "A simple dependency"
	help
		A simple dependency
```

## Buildroot/external/external_config_systemd/package/hello-systemd/Config.in
```kconfig
config BR2_PACKAGE_HELLO_SYSTEMD
	bool "systemd service example"
	depends on BR2_INIT_SYSTEMD
	help
		systemd service example

comment "The systemd example needs systemd !"
        depends on !BR2_INIT_SYSTEMD
	
```

## Buildroot/external/external_config_sysvinit/package/my_script/Config.in
```kconfig
config BR2_PACKAGE_MY_SCRIPT
	bool "My SysVInit script"
	help
		A simple SysVInit service
```

## Yocto/meta-example-book-ext/conf/layer.conf
```bitbake
# We have a conf and classes directory, add to BBPATH
BBPATH .= ":${LAYERDIR}"

# We have recipes-* directories, add to BBFILES
BBFILES += "${LAYERDIR}/recipes-*/*/*.bb \
            ${LAYERDIR}/recipes-*/*/*.bbappend"

BBFILE_COLLECTIONS += "meta-example-book-ext"
BBFILE_PATTERN_meta-example-book-ext = "^${LAYERDIR}/"
BBFILE_PRIORITY_meta-example-book-ext = "6"

LAYERDEPENDS_meta-example-book-ext = "core"
LAYERSERIES_COMPAT_meta-example-book-ext = "scarthgap"
```

## Yocto/meta-example-book/conf/distro/le6.conf
```bitbake
require conf/distro/poky.conf      
DISTRO = "le6"
DISTRO_NAME = "Example distro for the LE6 book"
DISTRO_VERSION = "1.0"
```

## Yocto/meta-example-book/conf/layer.conf
```bitbake
# We have a conf and classes directory, add to BBPATH
BBPATH .= ":${LAYERDIR}"

# We have recipes-* directories, add to BBFILES
BBFILES += "${LAYERDIR}/recipes-*/*/*.bb \
            ${LAYERDIR}/recipes-*/*/*.bbappend"

BBFILE_COLLECTIONS += "meta-example-book"
BBFILE_PATTERN_meta-example-book = "^${LAYERDIR}/"
BBFILE_PRIORITY_meta-example-book = "6"

LAYERDEPENDS_meta-example-book = "core"
LAYERSERIES_COMPAT_meta-example-book = "scarthgap"
```
